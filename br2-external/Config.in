## br2-external/Config.in
```kconfig
source "$BR2_EXTERNAL_CRISPAWN_PATH/package/crispawn-lvgl/Config.in"
source "$BR2_EXTERNAL_CRISPAWN_PATH/package/crispawn-noto-sans-jp/Config.in"
source "$BR2_EXTERNAL_CRISPAWN_PATH/package/crispawn-ui-runtime/Config.in"
```

## br2-external/configs/crispawn_community_x86_64_defconfig
```kconfig
BR2_x86_64=y
BR2_TOOLCHAIN_EXTERNAL=y
BR2_TOOLCHAIN_EXTERNAL_BOOTLIN=y
BR2_TOOLCHAIN_EXTERNAL_BOOTLIN_X86_64_MUSL_STABLE=y
BR2_TARGET_GENERIC_HOSTNAME="crispawn"
BR2_TARGET_GENERIC_ISSUE="CRISPAWN Community"
# BR2_TARGET_GENERIC_GETTY is not set
BR2_SYSTEM_DHCP=""
BR2_ROOTFS_DEVICE_CREATION_DYNAMIC_MDEV=y
BR2_PACKAGE_BUSYBOX_CONFIG_FRAGMENT_FILES="$(BR2_EXTERNAL_CRISPAWN_PATH)/board/common/busybox-community.config"
BR2_PACKAGE_CRISPAWN_UI_RUNTIME=y
BR2_PACKAGE_KMOD=y
BR2_PACKAGE_KMOD_TOOLS=y
BR2_TARGET_ROOTFS_CPIO=y
BR2_TARGET_ROOTFS_CPIO_XZ=y
# BR2_TARGET_ROOTFS_TAR is not set
BR2_TARGET_GRUB2=y
BR2_TARGET_GRUB2_I386_PC=y
BR2_TARGET_GRUB2_BOOT_PARTITION="cd"
BR2_TARGET_GRUB2_BUILTIN_MODULES_PC="boot linux normal iso9660 biosdisk"
BR2_PACKAGE_HOST_XORRISO=y
BR2_PACKAGE_HOST_MTOOLS=y
BR2_REPRODUCIBLE=y
```

## br2-external/package/bunbun-lvgl/Config.in
```kconfig
config BR2_PACKAGE_BUNBUN_LVGL
    bool "bunbun-lvgl"
    depends on BR2_INSTALL_LIBSTDCPP
    depends on !BR2_STATIC_LIBS
    select BR2_PACKAGE_FREETYPE
    select BR2_PACKAGE_LIBEVDEV
    help
      LVGL Open shared library configured for software framebuffer drawing,
      evdev keyboard input and FreeType fonts. No display server is needed.

comment "bunbun-lvgl needs a C++ toolchain and shared libraries"
    depends on !BR2_INSTALL_LIBSTDCPP || BR2_STATIC_LIBS
```

## br2-external/package/bunbun-noto-sans-jp/Config.in
```kconfig
config BR2_PACKAGE_BUNBUN_NOTO_SANS_JP
    bool "bunbun-noto-sans-jp"
    help
      Official Noto Sans JP Regular 2.004 OpenType font. The upstream
      Japanese regional font is included without a UI-text-only subset.
```

## br2-external/package/bunbun-ui-runtime/Config.in
```kconfig
config BR2_PACKAGE_BUNBUN_UI_RUNTIME
    bool "bunbun-ui-runtime"
    depends on BR2_INSTALL_LIBSTDCPP
    depends on !BR2_STATIC_LIBS
    select BR2_PACKAGE_BUNBUN_LVGL
    select BR2_PACKAGE_BUNBUN_NOTO_SANS_JP
    help
      Shared OS UI initialization: framebuffer, keyboard focus, Japanese
      font and event processing. Applications use the upstream LVGL API.
```

## br2-external/package/crispawn-lvgl/Config.in
```kconfig
config BR2_PACKAGE_CRISPAWN_LVGL
    bool "crispawn-lvgl"
    depends on BR2_INSTALL_LIBSTDCPP
    depends on !BR2_STATIC_LIBS
    select BR2_PACKAGE_FREETYPE
    select BR2_PACKAGE_LIBEVDEV
    help
      LVGL Open shared library configured for software framebuffer drawing,
      evdev keyboard input and FreeType fonts. No display server is needed.

comment "crispawn-lvgl needs a C++ toolchain and shared libraries"
    depends on !BR2_INSTALL_LIBSTDCPP || BR2_STATIC_LIBS
```

## br2-external/package/crispawn-noto-sans-jp/Config.in
```kconfig
config BR2_PACKAGE_CRISPAWN_NOTO_SANS_JP
    bool "crispawn-noto-sans-jp"
    help
      Official Noto Sans JP Regular 2.004 OpenType font. The upstream
      Japanese regional font is included without a UI-text-only subset.
```

## br2-external/package/crispawn-ui-runtime/Config.in
```kconfig
config BR2_PACKAGE_CRISPAWN_UI_RUNTIME
    bool "crispawn-ui-runtime"
    depends on BR2_INSTALL_LIBSTDCPP
    depends on !BR2_STATIC_LIBS
    select BR2_PACKAGE_CRISPAWN_LVGL
    select BR2_PACKAGE_CRISPAWN_NOTO_SANS_JP
    help
      Shared OS UI initialization: framebuffer, keyboard focus, Japanese
      font and event processing. Applications use the upstream LVGL API.
```
